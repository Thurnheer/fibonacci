## CMakeLists.txt
```
cmake_minimum_required(VERSION 3.13.1)

find_package(Zephyr REQUIRED HINTS $ENV{ZEPHYR_BASE})
project(test_fibonacci)

#target_link_libraries(app PRIVATE fibonacci::fibonacci)

target_include_directories(app
    PRIVATE
       ${CMAKE_CURRENT_SOURCE_DIR}/../include
)

target_sources(app
PRIVATE
	${CMAKE_CURRENT_SOURCE_DIR}/src/main.c
    ${CMAKE_CURRENT_SOURCE_DIR}/../src/fib.c
)
```

## prj.conf
```kconfig
CONFIG_ZTEST=y
CONFIG_CPLUSPLUS=y
CONFIG_STD_CPP2A=y
#Userspace is nice to have, but also uses quite much ROM
#and MinimAl does not support it either. Lets dactivate it.
CONFIG_USERSPACE=n
# Don't use the C++ lib! It will introduce exceptions to the code!
CONFIG_LIB_CPLUSPLUS=n
CONFIG_MAIN_STACK_SIZE=1024

CONFIG_LOG=y
```

## src/main.c
```c
#include <zephyr.h>
#include <ztest.h>
#include <fib.hpp>


static void test_fibonaci_expect_one(void)
{
	zassert_equal(1, fibonacci(1), "testin fibonacci");
}

void test_main(void)
{
	ztest_test_suite(fibonacci,
			 ztest_unit_test(test_fibonaci_expect_one)
        );
	ztest_run_test_suite(fibonacci);

}
```

## src/main.cpp
```c
#include <zephyr.h>
#include <ztest.h>
#include <fib.h>


static void test_turn_on(void)
{
	zassert_equal(1, fibonacci(1), "testin fibonacci");
}

void test_main(void)
{
	ztest_test_suite(test_fibonacci,
			 ztest_unit_test(test_turn_on)
            );
	ztest_run_test_suite(test_fibonacci);
}
```
